AUTOSAR XML (schema 4.0)
ar-package:
  module config Os_Test_Alarm: definition=Os, implementation-config-variant=RECOMMENDED-CONFIGURATION, module-description=Os_impl  # Alarm Test XML
    alarm1 (OsAlarm): OsAlarmCounterRef=counter1
      OsAlarmAction
        OsAlarmActivateTask: OsAlarmActivateTaskRef=OsTask1
      OsAlarmAutostart: OsAlarmAutostartType=ABSOLUTE, OsAlarmCycleTime=0, OsAlarmAlarmTime=1000, OsAlarmAppModeRef=app1
    app1 (OsAppMode)
    OsOS:
      OsNumberOfCores = 1
      OsTickPeriod = 0.001
      OsGenerateMemmap = 1
      OsGenerateLinkerFile = 1
      OsUseOrti = 1
      OsTickTimer = DECREMENTER
      OsGenerateMakefile = 1
      OsStackMonitoring = 0
      OsVleInstructionUsed = 1
      OsUseGetServiceId = 0
      OsUseParameterAccess = 0
      OsUseResScheduler = 0
      OsCore = p0
      OsTarget = RaspberryPI
      OsStatus = EXTENDED
      OsScalabilityClass = SC1
      OsHooks: OsErrorHook=0, OsPostTaskHook=0, OsPreTaskHook=0, OsProtectionHook=0, OsShutdownHook=0, OsStartupHook=0, OsExceptionHook=0
    OsResource1 (OsResource): OsResourceProperty=STANDARD
    3 x OsTask, all with OsTaskActivation=1, OsTaskStackSize=500:
      OsTask3: OsTaskSchedule=NON, OsTaskPriority=80
      OsTask2: OsTaskSchedule=FULL, OsTaskPriority=100, OsTaskResourceRef=OsResource1
      OsTask1: OsTaskSchedule=NON, OsTaskPriority=80, OsTaskResourceRef=OsResource1
    counter1 (OsCounter): OsCounterType=HARDWARE, OsCounterMaxAllowedValue=32000, OsCounterMinCycle=1, OsSecondsPerTick=0.001, OsCounterTicksPerBase=1
